## buildroot-2012.11.1/rpi_defconfig
```kconfig
BR2_arm=y
BR2_arm1176jzf_s=y
BR2_DL_DIR="/usr/local/arrival-dev/downloads"
BR2_CCACHE=y
BR2_GCC_VERSION_4_7_X=y
BR2_EXTRA_GCC_CONFIG_OPTIONS="--with-float=hard --with-fpu=vfp"
BR2_ENABLE_LOCALE_PURGE=y
BR2_ENABLE_LOCALE_WHITELIST="C en_US"
BR2_GENERATE_LOCALE="en_US"
# BR2_SOFT_FLOAT is not set
BR2_TARGET_OPTIMIZATION="-pipe -mfloat-abi=hard -mfpu=vfp"
BR2_TOOLCHAIN_BUILDROOT_LARGEFILE=y
BR2_TOOLCHAIN_BUILDROOT_INET_IPV6=y
BR2_TOOLCHAIN_BUILDROOT_INET_RPC=y
BR2_TOOLCHAIN_BUILDROOT_WCHAR=y
BR2_TOOLCHAIN_BUILDROOT_CXX=y
BR2_TARGET_GENERIC_HOSTNAME="rpi"
BR2_ROOTFS_DEVICE_CREATION_DYNAMIC_MDEV=y
BR2_PACKAGE_DROPBEAR=y
BR2_PACKAGE_OPENSSH=y
BR2_TARGET_ROOTFS_TAR_GZIP=y
BR2_LINUX_KERNEL=y
BR2_LINUX_KERNEL_CUSTOM_GIT=y
BR2_LINUX_KERNEL_CUSTOM_GIT_REPO_URL="https://github.com/raspberrypi/linux"
BR2_LINUX_KERNEL_CUSTOM_GIT_VERSION="rpi-3.6.y"
BR2_LINUX_KERNEL_DEFCONFIG="bcmrpi"
BR2_LINUX_KERNEL_ZIMAGE=y
```
